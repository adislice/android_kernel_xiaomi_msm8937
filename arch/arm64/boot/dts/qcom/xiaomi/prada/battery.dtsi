&vendor {
	/delete-node/ qcom,battery-data;
	mtp_batterydata: qcom,battery-data {
		qcom,batt-id-range-pct = <15>;
		#include "battery/coslight-4000mah.dtsi"
		#include "battery/scud-4000mah.dtsi"
	};
};

&qpnp_smbcharger {
	/delete-property/ qcom,chg-led-support;

	qcom,fastchg-current-comp = < 0x4b0 >;
	qcom,float-voltage-comp = < 0x0b >;
	qcom,float-voltage-mv = < 0x1130 >;

	qcom,iterm-ma = < 0xc8 >;
};

&qpnp_fg {
	qcom,cold-bat-decidegc = < 0x00 >;
	qcom,cool-bat-decidegc = < 0x64 >;

	qcom,fg-chg-iterm-ma = < 0xc8 >;

	qcom,fg-delta-soc = < 0x01 >;
	qcom,fg-iterm-ma = < 0xfa >;
	qcom,fg-vbat-estimate-diff-mv = < 0xc8 >;
	qcom,hold-soc-while-full;
	qcom,hot-bat-decidegc = < 0x258 >;
	qcom,resume-soc = < 0x63 >;
	qcom,warm-bat-decidegc = < 0x1c2 >;
};
